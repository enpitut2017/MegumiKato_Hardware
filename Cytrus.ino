// FaBo 202 9Axis MPU9250 - Version: Latest 
#include <FaBo9Axis_MPU9250.h>
#include <Wire.h>

//library for gps module
#include <TinyGPS++.h>
#include <SoftwareSerial.h>

//
#include <Bridge.h>
#include <BridgeServer.h>
#include <BridgeClient.h>
#include <FileIO.h>


#define pinGpsRx 10 //GPS Rx (Data Out) のピン番号
#define pinGpsTx 11 //GPS Tx (Data In) のピン番号

#define Brate 9600 //シリアル通信のボーレート

TinyGPSPlus gps;
SoftwareSerial mySerial(pinGpsRx, pinGpsTx);
//TinyGPSCustom magneticVariation(gps, "GPRMC", 10);

FaBo9Axis fabo_9axis;
 
void setup() {
  Serial.begin(Brate);
  while (!Serial) {
  ; // wait for serial port to connect. Needed for native USB port only
  }
 
  Serial.println("Begin");
  
  /* LED 13 */
  pinMode(13, OUTPUT);
  digitalWrite(13, HIGH);
  
  // set the data rate for the SoftwareSerial port
  mySerial.begin(9600);
  mySerial.println("Software Serial inited.");
  
  // mpu9250
  if (fabo_9axis.begin()) {
    Serial.println("configured FaBo 9Axis I2C Brick");
  } else {
    Serial.println("device error");
    while(1);
  }
}
 
void loop() { // run over and over
  /* accelerometer */
  float ax,ay,az;
  float gx,gy,gz;
  float mx,my,mz;
  float temp;
  
  fabo_9axis.readAccelXYZ(&ax,&ay,&az);
  fabo_9axis.readGyroXYZ(&gx,&gy,&gz);
  fabo_9axis.readMagnetXYZ(&mx,&my,&mz);
  fabo_9axis.readTemperature(&temp);


  /* pressure and bend */
  int ain0 = analogRead(0);
  int ain1 = analogRead(1);
  int ain2 = analogRead(2);
  int ain3 = analogRead(3);
  int ain4 = analogRead(4);
  int ain5 = analogRead(5);


  //GPSのシリアルデータの読み込み
  while (mySerial.available() > 0){
    char c_gps = mySerial.read();
    //Serial.print(c_gps);
    gps.encode(c_gps);
    
    if (gps.location.isValid()){
      Serial.print("LAT="); Serial.println(gps.location.lat(), 6);
      Serial.print("LONG="); Serial.println(gps.location.lng(), 6);
      Serial.print("ALT="); Serial.println(gps.altitude.meters());
      break;
  }
  
  Serial.print("Pressure:");
  Serial.print(ain0); Serial.print(",");
  Serial.print(ain1); Serial.print(",");
  Serial.print(ain2); Serial.print(",");
  Serial.print(ain3); Serial.println("");
  
  Serial.print("ax: ");
  Serial.print(ax);
  Serial.print(" ay: ");
  Serial.print(ay);
  Serial.print(" az: ");
  Serial.println(az);

  Serial.print("gx: ");
  Serial.print(gx);
  Serial.print(" gy: ");
  Serial.print(gy);
  Serial.print(" gz: ");
  Serial.println(gz);

  Serial.print("mx: ");
  Serial.print(mx);
  Serial.print(" my: ");
  Serial.print(my);
  Serial.print(" mz: ");
  Serial.println(mz);

  Serial.print("temp: ");
  Serial.println(temp);

  Serial.println("");
  
  
  delay(1000);
  //Serial.print("analog4:"); Serial.print(ain4);  
  //Serial.print("analog5:"); Serial.print(ain5);
  
}
